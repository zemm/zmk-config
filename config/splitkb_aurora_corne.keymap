/**
 * SplitKb Aurora Corne
 *
 * https://splitkb.com/collections/keyboard-kits/products/aurora-corne
 *
 */

// -----------------------------------------------------------------------------------------
// | 0   | 1   | 2   | 3   | 4   | 5   |     | 6   | 7   | 8   | 9   | 10  | 11  |
// | 12  | 13  | 14  | 15  | 16  | 17  |     | 18  | 19  | 20  | 21  | 22  | 23  |
// | 24  | 25  | 26  | 27  | 28  | 29  |     | 30  | 31  | 32  | 33  | 34  | 35  |
//                   | 36  | 37  | 38  |     | 39  | 40  | 41  |

#define KEYS_THUMBS 36 37 38 39 40 41
#define K_TL_AUX 36
#define K_TL_SEC 37
#define K_TL_PRI 38
//#define K_TM_PRI
#define K_TR_PRI 39
#define K_TR_SEC 40
#define K_TR_AUX 41

// The outer keys are the primary thumb keys for me on the Corne.
#define KM_THUMBS(L_SEC, L_PRI, L_AUX, MIDDLE, R_AUX, R_PRI, R_SEC) \
    L_AUX L_SEC L_PRI ___ R_PRI R_SEC R_AUX

#include "keymap/keymap.dtsi"
