## boards/shields/reviung41rgb/Kconfig.defconfig
```kconfig
# Copyright (c) 2020 The ZMK Contributors
# SPDX-License-Identifier: MIT

if SHIELD_REVIUNG41RGB

config ZMK_KEYBOARD_NAME
    default "Reviung41rgb"

endif
```

## boards/shields/reviung41rgb/Kconfig.shield
```kconfig
# Copyright (c) 2020 The ZMK Contributors
# SPDX-License-Identifier: MIT

config SHIELD_REVIUNG41RGB
    def_bool $(shields_list_contains,reviung41rgb)
```
