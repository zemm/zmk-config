/**
 * Bastard Keyboards TBK Mini with a custom wireless XIAO based controller
 *
 * https://github.com/Bastardkb/TBK-Mini
 * https://github.com/zemm/xiao-ble-adapter
 */

// -----------------------------------------------------------------------------------------
// | 0   | 1   | 2   | 3   | 4   | 5   |     | 6   | 7   | 8   | 9   | 10  | 11  |
// | 12  | 13  | 14  | 15  | 16  | 17  |     | 18  | 19  | 20  | 21  | 22  | 23  |
// | 24  | 25  | 26  | 27  | 28  | 29  |     | 30  | 31  | 32  | 33  | 34  | 35  |
//                   | 36  | 37  | 38  |     | 39  | 40  | 41  |

#define KEYS_THUMBS 36 37 38 39 40 41
#define K_TL_SEC 36
#define K_TL_PRI 37
#define K_TL_AUX 38
//#define K_TM_PRI
#define K_TR_AUX 39
#define K_TR_PRI 40
#define K_TR_SEC 41

// The middle keys are the primary thumb keys for me on the TBK Mini.
#define KM_THUMBS(L_SEC, L_PRI, L_AUX, MIDDLE, R_AUX, R_PRI, R_SEC) \
    L_SEC L_PRI L_AUX ___ R_AUX R_PRI R_SEC

/ {
	chosen {
		zmk,matrix_transform = &tbk_mini_transform;
	};
};

#include "keymap/keymap.dtsi"
