## boards/shields/reviung41z/Kconfig.defconfig
```kconfig
# Copyright (c) 2020 The ZMK Contributors
# SPDX-License-Identifier: MIT

if SHIELD_REVIUNG41Z

config ZMK_KEYBOARD_NAME
    default "Reviung41Z"

endif
```

## boards/shields/tbk_xiao_ble/Kconfig.shield
```kconfig
# Copyright (c) 2024 The ZMK Contributors
# SPDX-License-Identifier: MIT

config SHIELD_TBK_XIAO_BLE_LEFT
    def_bool $(shields_list_contains,tbk_xiao_ble_left)

config SHIELD_TBK_XIAO_BLE_RIGHT
    def_bool $(shields_list_contains,tbk_xiao_ble_right)
```
